## config/boards/shields/cool940tb/Kconfig.defconfig
```kconfig
if SHIELD_COOL940TB_R

config ZMK_KEYBOARD_NAME
    default "cool940tb_R"

config ZMK_SPLIT
    default y

config ZMK_SPLIT_ROLE_CENTRAL
    default y

endif

if SHIELD_COOL940TB_L

config ZMK_KEYBOARD_NAME
    default "cool940tb_L"

config ZMK_SPLIT
    default y

endif
```

## config/boards/shields/cool940tb/Kconfig.shield
```kconfig
config SHIELD_COOL940TB_R
    def_bool $(shields_list_contains,cool940tb_R)

config SHIELD_COOL940TB_L
    def_bool $(shields_list_contains,cool940tb_L)
```
